/******************************************************************************
* ASAP2 file: FSAC2021_V1.a2l
* Code generation for model "FSAC2021_V1".
* Model version : 1.219
* Simulink Coder version : 8.6 (R2014a) 27-Dec-2013
* C source code generated on : Sat Oct 30 18:49:48 2021
* Target selection: ec55xx.tlc
* Embedded hardware selection: Freescale MPC5500
* Code generation objectives: Unspecified
* Validation result: Not run
* (add additional file header information here)
******************************************************************************/ ASAP2_VERSION 1 31
/* Version 1.31 */
/begin PROJECT ECUCoderProject "ECUCoder Project"
/begin HEADER "Header Comments go here" /end HEADER
/begin MODULE ModuleName "No Comment"
/begin MOD_PAR "No Comment" /end MOD_PAR
/begin MOD_COMMON "No Comment" BYTE_ORDER MSB_FIRST /end MOD_COMMON
/begin RECORD_LAYOUT Scalar_BOOLEAN FNC_VALUES 1 UBYTE COLUMN_DIR DIRECT /end RECORD_LAYOUT
/begin RECORD_LAYOUT Scalar_UBYTE FNC_VALUES 1 UBYTE COLUMN_DIR DIRECT /end RECORD_LAYOUT
/begin RECORD_LAYOUT Scalar_BYTE FNC_VALUES 1 SBYTE COLUMN_DIR DIRECT /end RECORD_LAYOUT
/begin RECORD_LAYOUT Scalar_UWORD FNC_VALUES 1 UWORD COLUMN_DIR DIRECT /end RECORD_LAYOUT
/begin RECORD_LAYOUT Scalar_SWORD FNC_VALUES 1 SWORD COLUMN_DIR DIRECT /end RECORD_LAYOUT
/begin RECORD_LAYOUT Scalar_ULONG FNC_VALUES 1 ULONG COLUMN_DIR DIRECT /end RECORD_LAYOUT
/begin RECORD_LAYOUT Scalar_LONG FNC_VALUES 1 SLONG COLUMN_DIR DIRECT /end RECORD_LAYOUT
/begin RECORD_LAYOUT Scalar_FLOAT32_IEEE FNC_VALUES 1 FLOAT32_IEEE COLUMN_DIR DIRECT /end RECORD_LAYOUT
/begin RECORD_LAYOUT Scalar_FLOAT64_IEEE FNC_VALUES 1 FLOAT64_IEEE COLUMN_DIR DIRECT /end RECORD_LAYOUT
/begin RECORD_LAYOUT Lookup1D_BYTE FNC_VALUES 1 SBYTE COLUMN_DIR DIRECT /end RECORD_LAYOUT
/begin RECORD_LAYOUT Lookup1D_X_BYTE AXIS_PTS_X 1 SBYTE INDEX_INCR DIRECT /end RECORD_LAYOUT
/begin RECORD_LAYOUT Lookup1D_UBYTE FNC_VALUES 1 UBYTE COLUMN_DIR DIRECT /end RECORD_LAYOUT
/begin RECORD_LAYOUT Lookup1D_X_UBYTE AXIS_PTS_X 1 UBYTE INDEX_INCR DIRECT /end RECORD_LAYOUT
/begin RECORD_LAYOUT Lookup1D_UWORD FNC_VALUES 1 UWORD COLUMN_DIR DIRECT /end RECORD_LAYOUT
/begin RECORD_LAYOUT Lookup1D_X_UWORD AXIS_PTS_X 1 UWORD INDEX_INCR DIRECT /end RECORD_LAYOUT
/begin RECORD_LAYOUT Lookup1D_WORD FNC_VALUES 1 SWORD COLUMN_DIR DIRECT /end RECORD_LAYOUT
/begin RECORD_LAYOUT Lookup1D_X_WORD AXIS_PTS_X 1 SWORD INDEX_INCR DIRECT /end RECORD_LAYOUT
/begin RECORD_LAYOUT Lookup1D_ULONG FNC_VALUES 1 ULONG COLUMN_DIR DIRECT /end RECORD_LAYOUT
/begin RECORD_LAYOUT Lookup1D_X_ULONG AXIS_PTS_X 1 ULONG INDEX_INCR DIRECT /end RECORD_LAYOUT
/begin RECORD_LAYOUT Lookup1D_SLONG FNC_VALUES 1 SLONG COLUMN_DIR DIRECT /end RECORD_LAYOUT
/begin RECORD_LAYOUT Lookup1D_X_LONG AXIS_PTS_X 1 SLONG INDEX_INCR DIRECT /end RECORD_LAYOUT
/begin RECORD_LAYOUT Lookup1D_FLOAT32_IEEE FNC_VALUES 1 FLOAT32_IEEE COLUMN_DIR DIRECT /end RECORD_LAYOUT
/begin RECORD_LAYOUT Lookup1D_X_FLOAT32_IEEE AXIS_PTS_X 1 FLOAT32_IEEE INDEX_INCR DIRECT /end RECORD_LAYOUT
/begin RECORD_LAYOUT Lookup1D_FLOAT64_IEEE FNC_VALUES 1 FLOAT64_IEEE COLUMN_DIR DIRECT /end RECORD_LAYOUT
/begin RECORD_LAYOUT Lookup1D_X_FLOAT64_IEEE AXIS_PTS_X 1 FLOAT64_IEEE INDEX_INCR DIRECT /end RECORD_LAYOUT
/begin RECORD_LAYOUT Lookup2D_UBYTE FNC_VALUES 1 UBYTE COLUMN_DIR DIRECT /end RECORD_LAYOUT
/begin RECORD_LAYOUT Lookup2D_X_UBYTE AXIS_PTS_X 1 UBYTE INDEX_INCR DIRECT /end RECORD_LAYOUT
/begin RECORD_LAYOUT Lookup2D_BYTE FNC_VALUES 1 SBYTE COLUMN_DIR DIRECT /end RECORD_LAYOUT
/begin RECORD_LAYOUT Lookup2D_X_BYTE AXIS_PTS_X 1 SBYTE INDEX_INCR DIRECT /end RECORD_LAYOUT
/begin RECORD_LAYOUT Lookup2D_UWORD FNC_VALUES 1 UWORD COLUMN_DIR DIRECT /end RECORD_LAYOUT
/begin RECORD_LAYOUT Lookup2D_X_UWORD AXIS_PTS_X 1 UWORD INDEX_INCR DIRECT /end RECORD_LAYOUT
/begin RECORD_LAYOUT Lookup2D_WORD FNC_VALUES 1 SWORD COLUMN_DIR DIRECT /end RECORD_LAYOUT
/begin RECORD_LAYOUT Lookup2D_X_WORD AXIS_PTS_X 1 SWORD INDEX_INCR DIRECT /end RECORD_LAYOUT
/begin RECORD_LAYOUT Lookup2D_ULONG FNC_VALUES 1 ULONG COLUMN_DIR DIRECT /end RECORD_LAYOUT
/begin RECORD_LAYOUT Lookup2D_X_ULONG AXIS_PTS_X 1 ULONG INDEX_INCR DIRECT /end RECORD_LAYOUT
/begin RECORD_LAYOUT Lookup2D_LONG FNC_VALUES 1 SLONG COLUMN_DIR DIRECT /end RECORD_LAYOUT
/begin RECORD_LAYOUT Lookup2D_X_LONG AXIS_PTS_X 1 SLONG INDEX_INCR DIRECT /end RECORD_LAYOUT
/begin RECORD_LAYOUT Lookup2D_FLOAT32_IEEE FNC_VALUES 1 FLOAT32_IEEE COLUMN_DIR DIRECT /end RECORD_LAYOUT
/begin RECORD_LAYOUT Lookup2D_X_FLOAT32_IEEE AXIS_PTS_X 1 FLOAT32_IEEE INDEX_INCR DIRECT /end RECORD_LAYOUT
/begin RECORD_LAYOUT Lookup2D_FLOAT64_IEEE FNC_VALUES 1 FLOAT64_IEEE COLUMN_DIR DIRECT /end RECORD_LAYOUT
/begin RECORD_LAYOUT Lookup2D_X_FLOAT64_IEEE AXIS_PTS_X 1 FLOAT64_IEEE INDEX_INCR DIRECT /end RECORD_LAYOUT
/begin MEASUREMENT Voltage "" FLOAT64_IEEE FSAC2021_V1_CM_double 0 0 -1.7E+308 1.7E+308 ECU_ADDRESS @MemoryAddress@Voltage@ /end MEASUREMENT
/begin MEASUREMENT AMI_State "" FLOAT64_IEEE FSAC2021_V1_CM_double 0 0 -1.7E+308 1.7E+308 ECU_ADDRESS @MemoryAddress@AMI_State@ /end MEASUREMENT
/begin MEASUREMENT pulses "" FLOAT64_IEEE FSAC2021_V1_CM_double 0 0 -1.7E+308 1.7E+308 ECU_ADDRESS @MemoryAddress@pulses@ /end MEASUREMENT
/begin MEASUREMENT AMI "" FLOAT64_IEEE FSAC2021_V1_CM_double 0 0 -1.7E+308 1.7E+308 ECU_ADDRESS @MemoryAddress@AMI@ /end MEASUREMENT
/begin MEASUREMENT MODE "" FLOAT64_IEEE FSAC2021_V1_CM_double 0 0 -1.7E+308 1.7E+308 ECU_ADDRESS @MemoryAddress@MODE@ /end MEASUREMENT
/begin MEASUREMENT flag "" FLOAT64_IEEE FSAC2021_V1_CM_double 0 0 -1.7E+308 1.7E+308 ECU_ADDRESS @MemoryAddress@flag@ /end MEASUREMENT
/begin MEASUREMENT enflag "" FLOAT64_IEEE FSAC2021_V1_CM_double 0 0 -1.7E+308 1.7E+308 ECU_ADDRESS @MemoryAddress@enflag@ /end MEASUREMENT
/begin MEASUREMENT Motor_Spd "" FLOAT32_IEEE FSAC2021_V1_CM_single 0 0 -3.4E+38 3.4E+38 ECU_ADDRESS @MemoryAddress@Motor_Spd@ /end MEASUREMENT
/begin MEASUREMENT Vspd "" FLOAT32_IEEE FSAC2021_V1_CM_single 0 0 -3.4E+38 3.4E+38 ECU_ADDRESS @MemoryAddress@Vspd@ /end MEASUREMENT
/begin MEASUREMENT ACC "" FLOAT32_IEEE FSAC2021_V1_CM_single 0 0 -3.4E+38 3.4E+38 ECU_ADDRESS @MemoryAddress@ACC@ /end MEASUREMENT
/begin MEASUREMENT Steer_sensor_angle "" FLOAT32_IEEE FSAC2021_V1_CM_single 0 0 -3.4E+38 3.4E+38 ECU_ADDRESS @MemoryAddress@Steer_sensor_angle@ /end MEASUREMENT
/begin MEASUREMENT RES_Value "" FLOAT32_IEEE FSAC2021_V1_CM_single 0 0 -3.4E+38 3.4E+38 ECU_ADDRESS @MemoryAddress@RES_Value@ /end MEASUREMENT
/begin MEASUREMENT Read_compare_OutVolt "" FLOAT32_IEEE FSAC2021_V1_CM_single 0 0 -3.4E+38 3.4E+38 ECU_ADDRESS @MemoryAddress@Read_compare_OutVolt@ /end MEASUREMENT
/begin MEASUREMENT Back_Angle "" FLOAT32_IEEE FSAC2021_V1_CM_single 0 0 -3.4E+38 3.4E+38 ECU_ADDRESS @MemoryAddress@Back_Angle@ /end MEASUREMENT
/begin MEASUREMENT Read_Lft_Acc_Disp "" UWORD FSAC2021_V1_CM_uint16 0 0 0 65535 ECU_ADDRESS @MemoryAddress@Read_Lft_Acc_Disp@ /end MEASUREMENT
/begin MEASUREMENT Read_Right_Acc_Disp1 "" UWORD FSAC2021_V1_CM_uint16 0 0 0 65535 ECU_ADDRESS @MemoryAddress@Read_Right_Acc_Disp1@ /end MEASUREMENT
/begin MEASUREMENT Read_EBS_Gas_Prs1 "" UWORD FSAC2021_V1_CM_uint16 0 0 0 65535 ECU_ADDRESS @MemoryAddress@Read_EBS_Gas_Prs1@ /end MEASUREMENT
/begin MEASUREMENT Read_EBS_Gas_Prs2 "" UWORD FSAC2021_V1_CM_uint16 0 0 0 65535 ECU_ADDRESS @MemoryAddress@Read_EBS_Gas_Prs2@ /end MEASUREMENT
/begin MEASUREMENT Read_liquid_presuress "" UWORD FSAC2021_V1_CM_uint16 0 0 0 65535 ECU_ADDRESS @MemoryAddress@Read_liquid_presuress@ /end MEASUREMENT
/begin MEASUREMENT Str "" SBYTE FSAC2021_V1_CM_int8 0 0 -128 127 ECU_ADDRESS @MemoryAddress@Str@ /end MEASUREMENT
/begin MEASUREMENT ASSI_state "" UBYTE FSAC2021_V1_CM_uint8 0 0 0 255 ECU_ADDRESS @MemoryAddress@ASSI_state@ /end MEASUREMENT
/begin MEASUREMENT Brk_Enable_Flag "" UBYTE FSAC2021_V1_CM_uint8 0 0 0 255 ECU_ADDRESS @MemoryAddress@Brk_Enable_Flag@ /end MEASUREMENT
/begin MEASUREMENT RES_EBS "" UBYTE FSAC2021_V1_CM_uint8 0 0 0 255 ECU_ADDRESS @MemoryAddress@RES_EBS@ /end MEASUREMENT
/begin MEASUREMENT EBS_light "" UBYTE FSAC2021_V1_CM_uint8 0 0 0 255 ECU_ADDRESS @MemoryAddress@EBS_light@ /end MEASUREMENT
/begin MEASUREMENT Metoc_Move "" UBYTE FSAC2021_V1_CM_uint8 0 0 0 255 ECU_ADDRESS @MemoryAddress@Metoc_Move@ /end MEASUREMENT
/begin MEASUREMENT MNT_SEND "" UBYTE FSAC2021_V1_CM_uint8 0 0 0 255 ECU_ADDRESS @MemoryAddress@MNT_SEND@ /end MEASUREMENT
/begin MEASUREMENT ENCODER_SEND "" UBYTE FSAC2021_V1_CM_uint8 0 0 0 255 ECU_ADDRESS @MemoryAddress@ENCODER_SEND@ /end MEASUREMENT
/begin MEASUREMENT Read_BCU "" UBYTE FSAC2021_V1_CM_uint8 0 0 0 255 ECU_ADDRESS @MemoryAddress@Read_BCU@ /end MEASUREMENT
/begin MEASUREMENT read_speed "" UBYTE FSAC2021_V1_CM_uint8 0 0 0 255 ECU_ADDRESS @MemoryAddress@read_speed@ /end MEASUREMENT
/begin MEASUREMENT ASMS_VALUE "" UBYTE FSAC2021_V1_CM_uint8 0 0 0 255 ECU_ADDRESS @MemoryAddress@ASMS_VALUE@ /end MEASUREMENT
/begin MEASUREMENT Steer_Status "" UBYTE FSAC2021_V1_CM_uint8 0 0 0 255 ECU_ADDRESS @MemoryAddress@Steer_Status@ /end MEASUREMENT
/begin MEASUREMENT motec_node "" UBYTE FSAC2021_V1_CM_uint8 0 0 0 255 ECU_ADDRESS @MemoryAddress@motec_node@ /end MEASUREMENT
/begin MEASUREMENT bms_node "" UBYTE FSAC2021_V1_CM_uint8 0 0 0 255 ECU_ADDRESS @MemoryAddress@bms_node@ /end MEASUREMENT
/begin MEASUREMENT To_AMI_OK "" UBYTE FSAC2021_V1_CM_uint8 0 0 0 255 ECU_ADDRESS @MemoryAddress@To_AMI_OK@ /end MEASUREMENT
/begin MEASUREMENT strsr_node "" UBYTE FSAC2021_V1_CM_uint8 0 0 0 255 ECU_ADDRESS @MemoryAddress@strsr_node@ /end MEASUREMENT
/begin MEASUREMENT brake_node "" UBYTE FSAC2021_V1_CM_uint8 0 0 0 255 ECU_ADDRESS @MemoryAddress@brake_node@ /end MEASUREMENT
/begin MEASUREMENT RES__ok "" UBYTE FSAC2021_V1_CM_uint8 0 0 0 255 ECU_ADDRESS @MemoryAddress@RES__ok@ /end MEASUREMENT
/begin MEASUREMENT error_left "" UBYTE FSAC2021_V1_CM_uint8 0 0 0 255 ECU_ADDRESS @MemoryAddress@error_left@ /end MEASUREMENT
/begin MEASUREMENT error_right "" UBYTE FSAC2021_V1_CM_uint8 0 0 0 255 ECU_ADDRESS @MemoryAddress@error_right@ /end MEASUREMENT
/begin MEASUREMENT error_liquid "" UBYTE FSAC2021_V1_CM_uint8 0 0 0 255 ECU_ADDRESS @MemoryAddress@error_liquid@ /end MEASUREMENT
/begin MEASUREMENT error_gas1 "" UBYTE FSAC2021_V1_CM_uint8 0 0 0 255 ECU_ADDRESS @MemoryAddress@error_gas1@ /end MEASUREMENT
/begin MEASUREMENT error_gas2 "" UBYTE FSAC2021_V1_CM_uint8 0 0 0 255 ECU_ADDRESS @MemoryAddress@error_gas2@ /end MEASUREMENT
/begin MEASUREMENT res_go "" UBYTE FSAC2021_V1_CM_uint8 0 0 0 255 ECU_ADDRESS @MemoryAddress@res_go@ /end MEASUREMENT
/begin MEASUREMENT res_ebs_value "" UBYTE FSAC2021_V1_CM_uint8 0 0 0 255 ECU_ADDRESS @MemoryAddress@res_ebs_value@ /end MEASUREMENT
/begin MEASUREMENT To_MOTOR_OK "" UBYTE FSAC2021_V1_CM_uint8 0 0 0 255 ECU_ADDRESS @MemoryAddress@To_MOTOR_OK@ /end MEASUREMENT
/begin MEASUREMENT motor_node "" UBYTE FSAC2021_V1_CM_uint8 0 0 0 255 ECU_ADDRESS @MemoryAddress@motor_node@ /end MEASUREMENT
/begin MEASUREMENT AMI_HEART "" UBYTE FSAC2021_V1_CM_uint8 0 0 0 255 ECU_ADDRESS @MemoryAddress@AMI_HEART@ /end MEASUREMENT
/begin MEASUREMENT TS_Flag "" UBYTE FSAC2021_V1_CM_uint8 0 0 0 255 ECU_ADDRESS @MemoryAddress@TS_Flag@ /end MEASUREMENT
/begin MEASUREMENT EBS_Status "" UBYTE FSAC2021_V1_CM_uint8 0 0 0 255 ECU_ADDRESS @MemoryAddress@EBS_Status@ /end MEASUREMENT
/begin MEASUREMENT BUC_Enable_Flag "" UBYTE FSAC2021_V1_CM_uint8 0 0 0 255 ECU_ADDRESS @MemoryAddress@BUC_Enable_Flag@ /end MEASUREMENT
/begin MEASUREMENT EBS_Sensor_light "" UBYTE FSAC2021_V1_CM_boolean 0 0 0 1 ECU_ADDRESS @MemoryAddress@EBS_Sensor_light@ /end MEASUREMENT
/begin MEASUREMENT sensor_erroe "" UBYTE FSAC2021_V1_CM_boolean 0 0 0 1 ECU_ADDRESS @MemoryAddress@sensor_erroe@ /end MEASUREMENT
/begin MEASUREMENT Node_Lost "" UBYTE FSAC2021_V1_CM_boolean 0 0 0 1 ECU_ADDRESS @MemoryAddress@Node_Lost@ /end MEASUREMENT
/begin MEASUREMENT light_blue "" UBYTE FSAC2021_V1_CM_boolean 0 0 0 1 ECU_ADDRESS @MemoryAddress@light_blue@ /end MEASUREMENT
/begin MEASUREMENT Buzzer_pin "" UBYTE FSAC2021_V1_CM_boolean 0 0 0 1 ECU_ADDRESS @MemoryAddress@Buzzer_pin@ /end MEASUREMENT
/begin MEASUREMENT Stafe_Relay_pin "" UBYTE FSAC2021_V1_CM_boolean 0 0 0 1 ECU_ADDRESS @MemoryAddress@Stafe_Relay_pin@ /end MEASUREMENT
/begin MEASUREMENT V48_relay "" UBYTE FSAC2021_V1_CM_boolean 0 0 0 1 ECU_ADDRESS @MemoryAddress@V48_relay@ /end MEASUREMENT
/begin MEASUREMENT R2D_Voltage "" UBYTE FSAC2021_V1_CM_boolean 0 0 0 1 ECU_ADDRESS @MemoryAddress@R2D_Voltage@ /end MEASUREMENT
/begin MEASUREMENT IMD "" UBYTE FSAC2021_V1_CM_boolean 0 0 0 1 ECU_ADDRESS @MemoryAddress@IMD@ /end MEASUREMENT
/begin MEASUREMENT EBS "" UBYTE FSAC2021_V1_CM_boolean 0 0 0 1 ECU_ADDRESS @MemoryAddress@EBS@ /end MEASUREMENT
/begin MEASUREMENT BMS_LIGHT "" UBYTE FSAC2021_V1_CM_boolean 0 0 0 1 ECU_ADDRESS @MemoryAddress@BMS_LIGHT@ /end MEASUREMENT
/begin MEASUREMENT brake_light "" UBYTE FSAC2021_V1_CM_boolean 0 0 0 1 ECU_ADDRESS @MemoryAddress@brake_light@ /end MEASUREMENT
/begin MEASUREMENT LVMS_Read "" UBYTE FSAC2021_V1_CM_boolean 0 0 0 1 ECU_ADDRESS @MemoryAddress@LVMS_Read@ /end MEASUREMENT
/begin MEASUREMENT HVMS_Read "" UBYTE FSAC2021_V1_CM_boolean 0 0 0 1 ECU_ADDRESS @MemoryAddress@HVMS_Read@ /end MEASUREMENT
/begin MEASUREMENT ASMS_Read "" UBYTE FSAC2021_V1_CM_boolean 0 0 0 1 ECU_ADDRESS @MemoryAddress@ASMS_Read@ /end MEASUREMENT
/begin MEASUREMENT On_Out_Switch "" UBYTE FSAC2021_V1_CM_boolean 0 0 0 1 ECU_ADDRESS @MemoryAddress@On_Out_Switch@ /end MEASUREMENT
/begin MEASUREMENT START "" UBYTE FSAC2021_V1_CM_boolean 0 0 0 1 ECU_ADDRESS @MemoryAddress@START@ /end MEASUREMENT
/begin MEASUREMENT On_IN_Switch "" UBYTE FSAC2021_V1_CM_boolean 0 0 0 1 ECU_ADDRESS @MemoryAddress@On_IN_Switch@ /end MEASUREMENT
/begin MEASUREMENT HV_LIGHT "" UBYTE FSAC2021_V1_CM_boolean 0 0 0 1 ECU_ADDRESS @MemoryAddress@HV_LIGHT@ /end MEASUREMENT
/begin MEASUREMENT EBS_Rel_Switch "" UBYTE FSAC2021_V1_CM_boolean 0 0 0 1 ECU_ADDRESS @MemoryAddress@EBS_Rel_Switch@ /end MEASUREMENT
/begin MEASUREMENT Compare_Voltage "" UBYTE FSAC2021_V1_CM_boolean 0 0 0 1 ECU_ADDRESS @MemoryAddress@Compare_Voltage@ /end MEASUREMENT
/begin MEASUREMENT enable "" UBYTE FSAC2021_V1_CM_boolean 0 0 0 1 ECU_ADDRESS @MemoryAddress@enable@ /end MEASUREMENT
/begin MEASUREMENT blue "" UBYTE FSAC2021_V1_CM_uint8 0 0 0 255 ECU_ADDRESS @MemoryAddress@blue@ /end MEASUREMENT
/begin MEASUREMENT motor "" UBYTE FSAC2021_V1_CM_uint8 0 0 0 255 ECU_ADDRESS @MemoryAddress@motor@ /end MEASUREMENT
/begin MEASUREMENT Vel_spd "" FLOAT32_IEEE FSAC2021_V1_CM_single 0 0 -3.4E+38 3.4E+38 ECU_ADDRESS @MemoryAddress@Vel_spd@ /end MEASUREMENT
/begin COMPU_METHOD FSAC2021_V1_CM_double "Q = V" RAT_FUNC "%15.10" "" COEFFS 0 1 0 0 0 1 /end COMPU_METHOD
/begin COMPU_METHOD FSAC2021_V1_CM_single "Q = V" RAT_FUNC "%8.6" "" COEFFS 0 1 0 0 0 1 /end COMPU_METHOD
/begin COMPU_METHOD FSAC2021_V1_CM_uint16 "Q = V" RAT_FUNC "%5.0" "" COEFFS 0 1 0 0 0 1 /end COMPU_METHOD
/begin COMPU_METHOD FSAC2021_V1_CM_int8 "Q = V" RAT_FUNC "%3.0" "" COEFFS 0 1 0 0 0 1 /end COMPU_METHOD
/begin COMPU_METHOD FSAC2021_V1_CM_uint8 "Q = V" RAT_FUNC "%3.0" "" COEFFS 0 1 0 0 0 1 /end COMPU_METHOD
/begin COMPU_METHOD FSAC2021_V1_CM_boolean "Q = V" RAT_FUNC "%1.0" "" COEFFS 0 1 0 0 0 1 /end COMPU_METHOD
/begin GROUP FSAC2021_V1 "FSAC2021_V1" /* Root */ ROOT
 /begin SUB_GROUP Root_CAN_SEND Root_Controller Root_DIAG Root_I__O_OutPut Root_Input_Process Root_VCU_CAN_Read Root_VCU_KL_Read /end SUB_GROUP
/end GROUP
/begin GROUP Root_CAN_SEND "FSAC2021_V1/CAN_SEND"
 /begin SUB_GROUP S1_Subsystem1 S1_Subsystem2 S1_Subsystem3 S1__BRK_STR_DRIVER_ /end SUB_GROUP
 /begin REF_MEASUREMENT ACC ASSI_state Motor_Spd Voltage Vspd pulses /end REF_MEASUREMENT
/end GROUP
/begin GROUP Root_Controller "FSAC2021_V1/Controller" /begin SUB_GROUP S2_200ms_Duty S2_50ms_Duty S2_SteerCtr /end SUB_GROUP
 /begin REF_MEASUREMENT AMI_State Brk_Enable_Flag EBS_Sensor_light EBS_light RES_EBS /end REF_MEASUREMENT
/end GROUP
/begin GROUP Root_DIAG "FSAC2021_V1/DIAG" /begin SUB_GROUP S3_DIAG /end SUB_GROUP /begin REF_MEASUREMENT ASMS_VALUE /end REF_MEASUREMENT /end GROUP
/begin GROUP Root_I__O_OutPut "FSAC2021_V1/I//O_OutPut" /begin SUB_GROUP S4_Subsystem /end SUB_GROUP /end GROUP
/begin GROUP Root_Input_Process "FSAC2021_V1/Input_Process" /begin SUB_GROUP S5_KL_Sig_Process /end SUB_GROUP /end GROUP
/begin GROUP Root_VCU_CAN_Read "FSAC2021_V1/VCU_CAN_Read"
 /begin SUB_GROUP S8_PCANA_RES_AMI_MOTEC_BRAKE_STEER_SENSOR_IPC_ S8_PCANB_BMS_DRIVE_MOTOR_ S8_Subsystem S8_Subsystem1 S8_Subsystem2 /end SUB_GROUP
/end GROUP
/begin GROUP Root_VCU_KL_Read "FSAC2021_V1/VCU_KL_Read" /begin SUB_GROUP S9_Read_VCU_AnaInput S9_Read_VCU_DigInput /end SUB_GROUP /end GROUP
/begin GROUP S1__BRK_STR_DRIVER_ "FSAC2021_V1/CAN_SEND/(BRK、STR、DRIVER)" /begin REF_MEASUREMENT To_AMI_OK /end REF_MEASUREMENT /end GROUP
/begin GROUP S1_Subsystem1 "FSAC2021_V1/CAN_SEND/Subsystem1" /begin SUB_GROUP S11_Brk_Mtr_Enbale /end SUB_GROUP /begin REF_MEASUREMENT ENCODER_SEND MNT_SEND Metoc_Move /end REF_MEASUREMENT /end GROUP
/begin GROUP S1_Subsystem2 "FSAC2021_V1/CAN_SEND/Subsystem2" /begin REF_MEASUREMENT To_MOTOR_OK /end REF_MEASUREMENT /end GROUP
/begin GROUP S1_Subsystem3 "FSAC2021_V1/CAN_SEND/Subsystem3" /begin REF_MEASUREMENT Read_BCU read_speed /end REF_MEASUREMENT /end GROUP
/begin GROUP S2_200ms_Duty "FSAC2021_V1/Controller/200ms_Duty" /begin SUB_GROUP S64_Light_Subsystem /end SUB_GROUP /end GROUP
/begin GROUP S2_50ms_Duty "FSAC2021_V1/Controller/50ms_Duty" /begin SUB_GROUP S65_EBS_Judge S65_HV_Judge_ S65_Subsystem /end SUB_GROUP /end GROUP
/begin GROUP S2_SteerCtr "FSAC2021_V1/Controller/SteerCtr" /begin SUB_GROUP S67_Subsystem3 /end SUB_GROUP /begin REF_MEASUREMENT Str enflag flag /end REF_MEASUREMENT /end GROUP
/begin GROUP S3_DIAG "FSAC2021_V1/DIAG/DIAG"
 /begin SUB_GROUP S135_Analog_Sensor_Diag S135_CAN_NODE_LOSTCOM S135_Res_Diag /end SUB_GROUP
/end GROUP
/begin GROUP S4_Subsystem "FSAC2021_V1/I//O_OutPut/Subsystem"
 /begin REF_MEASUREMENT BMS_LIGHT Buzzer_pin EBS IMD R2D_Voltage Stafe_Relay_pin V48_relay brake_light light_blue /end REF_MEASUREMENT
/end GROUP
/begin GROUP S5_KL_Sig_Process "FSAC2021_V1/Input_Process/KL_Sig_Process" /begin SUB_GROUP S208_Whl_Spd_Process /end SUB_GROUP /end GROUP
/begin GROUP S8_PCANA_RES_AMI_MOTEC_BRAKE_STEER_SENSOR_IPC_ "FSAC2021_V1/VCU_CAN_Read/PCANA(RES、AMI、MOTEC、BRAKE、STEER_SENSOR、IPC)" /begin SUB_GROUP S247_Res_Message1 S247_STEER_SENSOR_INFO1 /end SUB_GROUP /begin REF_MEASUREMENT RES__ok brake_node strsr_node /end REF_MEASUREMENT /end GROUP
/begin GROUP S8_PCANB_BMS_DRIVE_MOTOR_ "FSAC2021_V1/VCU_CAN_Read/PCANB(BMS、DRIVE_MOTOR)" /begin REF_MEASUREMENT AMI AMI_HEART motor_node /end REF_MEASUREMENT /end GROUP
/begin GROUP S8_Subsystem "FSAC2021_V1/VCU_CAN_Read/Subsystem" /begin REF_MEASUREMENT bms_node /end REF_MEASUREMENT /end GROUP
/begin GROUP S8_Subsystem1 "FSAC2021_V1/VCU_CAN_Read/Subsystem1" /begin REF_MEASUREMENT motec_node /end REF_MEASUREMENT /end GROUP
/begin GROUP S8_Subsystem2 "FSAC2021_V1/VCU_CAN_Read/Subsystem2" /begin REF_MEASUREMENT Steer_Status /end REF_MEASUREMENT /end GROUP
/begin GROUP S9_Read_VCU_AnaInput "FSAC2021_V1/VCU_KL_Read/Read_VCU_AnaInput"
 /begin REF_MEASUREMENT Read_EBS_Gas_Prs1 Read_EBS_Gas_Prs2 Read_Lft_Acc_Disp Read_Right_Acc_Disp1 Read_compare_OutVolt Read_liquid_presuress /end REF_MEASUREMENT
/end GROUP
/begin GROUP S9_Read_VCU_DigInput "FSAC2021_V1/VCU_KL_Read/Read_VCU_DigInput"
 /begin REF_MEASUREMENT ASMS_Read EBS_Rel_Switch HVMS_Read HV_LIGHT LVMS_Read On_IN_Switch On_Out_Switch START /end REF_MEASUREMENT
/end GROUP
/begin GROUP S11_Brk_Mtr_Enbale "FSAC2021_V1/CAN_SEND/Subsystem1/Brk_Mtr_Enbale" /begin REF_MEASUREMENT BUC_Enable_Flag /end REF_MEASUREMENT /end GROUP
/begin GROUP S64_Light_Subsystem "FSAC2021_V1/Controller/200ms_Duty/Light_Subsystem" /begin REF_MEASUREMENT blue /end REF_MEASUREMENT /end GROUP
/begin GROUP S65_EBS_Judge "FSAC2021_V1/Controller/50ms_Duty/EBS_Judge" /begin REF_MEASUREMENT EBS_Status /end REF_MEASUREMENT /end GROUP
/begin GROUP S65_HV_Judge_ "FSAC2021_V1/Controller/50ms_Duty/HV_Judge " /begin REF_MEASUREMENT Compare_Voltage TS_Flag /end REF_MEASUREMENT /end GROUP
/begin GROUP S65_Subsystem "FSAC2021_V1/Controller/50ms_Duty/Subsystem" /begin REF_MEASUREMENT MODE enable /end REF_MEASUREMENT /end GROUP
/begin GROUP S67_Subsystem3 "FSAC2021_V1/Controller/SteerCtr/Subsystem3" /begin REF_MEASUREMENT Back_Angle /end REF_MEASUREMENT /end GROUP
/begin GROUP S135_Analog_Sensor_Diag "FSAC2021_V1/DIAG/DIAG/Analog_Sensor_Diag"
 /begin REF_MEASUREMENT error_gas1 error_gas2 error_left error_liquid error_right sensor_erroe /end REF_MEASUREMENT
/end GROUP
/begin GROUP S135_CAN_NODE_LOSTCOM "FSAC2021_V1/DIAG/DIAG/CAN_NODE_LOSTCOM" /begin SUB_GROUP S140_Subsystem /end SUB_GROUP /begin REF_MEASUREMENT Node_Lost /end REF_MEASUREMENT /end GROUP
/begin GROUP S135_Res_Diag "FSAC2021_V1/DIAG/DIAG/Res_Diag" /begin SUB_GROUP S142_Subsystem /end SUB_GROUP /end GROUP
/begin GROUP S208_Whl_Spd_Process "FSAC2021_V1/Input_Process/KL_Sig_Process/Whl_Spd_Process" /begin SUB_GROUP S210_Whl2Veh_Spd_Trans /end SUB_GROUP /end GROUP
/begin GROUP S247_Res_Message1 "FSAC2021_V1/VCU_CAN_Read/PCANA(RES、AMI、MOTEC、BRAKE、STEER_SENSOR、IPC)/Res_Message1" /begin REF_MEASUREMENT RES_Value /end REF_MEASUREMENT /end GROUP
/begin GROUP S247_STEER_SENSOR_INFO1 "FSAC2021_V1/VCU_CAN_Read/PCANA(RES、AMI、MOTEC、BRAKE、STEER_SENSOR、IPC)/STEER_SENSOR_INFO1" /begin REF_MEASUREMENT Steer_sensor_angle /end REF_MEASUREMENT /end GROUP
/begin GROUP S140_Subsystem "FSAC2021_V1/DIAG/DIAG/CAN_NODE_LOSTCOM/Subsystem" /begin REF_MEASUREMENT motor /end REF_MEASUREMENT /end GROUP
/begin GROUP S142_Subsystem "FSAC2021_V1/DIAG/DIAG/Res_Diag/Subsystem" /begin REF_MEASUREMENT res_ebs_value res_go /end REF_MEASUREMENT /end GROUP
/begin GROUP S210_Whl2Veh_Spd_Trans "FSAC2021_V1/Input_Process/KL_Sig_Process/Whl_Spd_Process/Whl2Veh_Spd_Trans" /begin SUB_GROUP S217_Round /end SUB_GROUP /end GROUP
/begin GROUP S217_Round "FSAC2021_V1/Input_Process/KL_Sig_Process/Whl_Spd_Process/Whl2Veh_Spd_Trans/Round" /begin REF_MEASUREMENT Vel_spd /end REF_MEASUREMENT /end GROUP
/end MODULE
/end PROJECT
/* (add any file trailer comments here) */
/* EOF FSAC2021_V1.a2l */
